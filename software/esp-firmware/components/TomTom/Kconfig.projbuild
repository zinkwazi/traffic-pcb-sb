## software/esp-firmware/main/Kconfig.projbuild
```kconfig
menu "Main Application"

    config HARDWARE_VERSION
        string "PCB Hardware Version"
        default "V1_0"
        help
            The version of the PCB that this build is running on, which
            lets the firmware know the capabilities of the board.

    config FIRMWARE_VERSION
        string "Traffic Firmware Version"
        default "_0"
        help
            The version of firmware this build corresponds to.
    
    config SERVER_FIRMWARE_VERSION
        string "Server Firmware Version"
        default "_0"
        help
            The version of firmware this build tells the server it is. That is,
            it accesses the data file corresponding to this firmware version.

    config FIRMWARE_CONF
        string "Traffic Firmware Configuration"
        default "UUUU"
        help
            An indication of this build's build specific config values.
            Syntax: [A/F/U: api data/fake data/undef][slow color][med color][fast color].

    config LED_REFRESH_PERIOD
        int "LED Refresh Period"
        default 60
        help
            The amount of time in minutes between LED refreshes.

    config ERROR_PERIOD
        int "Error Flash Period"
        default 500
        help
            The amount of time in milliseconds (1/1000th of a second) between 
            error LED toggling for TomTom errors.

    config LED_UPDATE_PERIOD
        int "LED Update Period"
        default 100
        help
            The amount of time in milliseconds (1/1000th of a second) between 
            LED color updates.

    config LED_CLEAR_PERIOD
        int "LED Clear Period"
        default 100
        help
            The amount of time in milliseconds (1/1000th of a second) between 
            clearing of LEDs.

    config DEBOUNCE_PERIOD
        int "Button Debounce Period"
        default 200
        help
            The amount of time in milliseconds (1/1000th of a second) that
            additional button interrupts will not be registered after an initial interrupt.

    config OTA_LEFT_ON_MS
        int "OTA Left On Time"
        default 1000
        help
            The amount of time to leave the direction LEDs on after an OTA update has failed.

    config NUM_RETRY_HTTP_REQUEST
        int "Num Retry HTTP Request"
        default 5
        help
            The number of times to retry a TomTom HTTP request, which has a 
            small chance to fail to resolve the hostname.

    config FIRMWARE_UPGRADE_SERVER
        string "Firmware Upgrade Server"
        help
            The server to query for the latest firmware binary file for this device.

    config DATA_SERVER
        string "Data Server"
        default "https://bearanvil.com"
        help
            The server to request updated segment speed data from.

    config MAX_DATA_URL_LEN
        int "Max Data URL Length"
        default 60
        help
            The maximum length that the URL of the current data from
            the data server can be, not including null terminator. 
            ex: "https://bearanvil.com/current_data/data_north_V1_0_0.json" -> 57

    config USE_FAKE_DATA
        bool "Use Fake API Data"
        default true
        help
            Whether the TomTom component should simulate API
            data or actually make API calls using the provided API key.

    config TIMER_CAUSES_TOGGLE
        bool "Timer Causes Toggle"
        default false
        help
            Whether the LED refresh timer should cause the current direction
            of traffic being displayed to be toggled.

    config GLOBAL_LED_CURRENT
        int "Global LED Current"
        default 112
        help
            The maximum current that is delivered to an LED, which is also
            the current delivered to an LED with a scaling factor of 0xFF.
            This value should not exceed 0x80 (128) as that corresponds to the
            maximum operating current that an LED can handle.
    
    config SLOW_CUTOFF_PERCENT
        int "Slow LED Cutoff"
        default 50
        help
            The percentage of road segment free flow speed below which the current
            segment speed is considered slow, exclusive of the cutoff. This
            should be lower than MEDIUM_CUTOFF_PERCENT.

    config MEDIUM_CUTOFF_PERCENT
        int "Medium LED Cutoff"
        default 80
        help
            The percentage of road segment free flow speed below which the current
            segment speed is considered medium, exclusive of the cutoff. This should
            be higher than SLOW_CUTOFF_PERCENT.

    config MAIN_PRIO
        int "Priority of the main task"
        default 3

    config WORKER_STACK
        int "Stack size in bytes of the worker task"
        default 4184
    
    config WORKER_PRIO
        int "Priority of the worker task"
        default 1
    
    config OTA_STACK
        int "Stack size in bytes of the OTA task"
        default 3584

    config OTA_PRIO
        int "Priority of the OTA task"
        default 4

endmenu
```

## software/esp-manual-tests/main/Kconfig.projbuild
```kconfig
menu "Test Application"

    config RUN_PINOUT_TEST
        bool "Run Pinout Test"
        default true
    
    config RUN_POWER_TEST
        bool "Run Power Test"
        default true

    config RUN_LED_COLOR_TEST
        bool "Run LED Color Test"
        default true

endmenu
```

## software/esp-unity-test-app/components/test_config/KConfig.projbuild
```kconfig
menu "Test Configuration"

    config TEST_WIFI_SSID
        string "Test Wifi SSID"
        default "test_ssid"
        help
            "SSID of the wifi network to connect to for testing."
    
    config TEST_WIFI_PASSWORD
        string "Test Wifi Password"
        default "test_pass"
        help
            "Password of the wifi network to connect to for testing."

endmenu
```
