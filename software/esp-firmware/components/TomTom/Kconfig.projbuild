## software/esp-firmware/components/TomTom/Kconfig.projbuild
```kconfig
menu "TomTom"

    config USE_FAKE_DATA
        bool "Use Fake API Data"
        default true
        help
            Whether the TomTom component should simulate API
            data or actually make API calls using the provided API key.
        
endmenu
```

## software/esp-firmware/components/actions/KConfig.projbuild
```kconfig
menu "Action Task"

    config ACTION_STACK
        int "Action Task Stack Size"
        default 5000
        help
            The stack size in bytes of the action task.

    config ACTION_PRIO
        int "Action Task Priority"
        default 1
        help
            The priority of the action task.

endmenu
```

## software/esp-firmware/components/actions/test/KConfig.projbuild
```kconfig
menu "Actions Test"

    config ACTIONS_MAIN
        int "Test Actions Main App"
        default 1
        help
            The test_actions_main file used to run the tests, which
            controls which tests are compiled.

    config ACTIONS_TEST_DATA_SERVER
        string "Test Data Server"
        default "https://bearanvil.com"
        help
            The server to request updated segment speed data from.

    config ACTIONS_TEST_DATA_BASE_URL
        string "Test Data Base URL"
        default "/test_data/test_actions_data"
        help
            The base page for the test data files on the test data server.

endmenu
```

## software/esp-firmware/components/animations/KConfig.projbuild
```kconfig
menu "Animations"

    config SUPPORT_STROBING
        bool "Support Strobing"
        default false
        help
            Whether or not strobing should be enabled. This may be 
            required to be false to meet binary size requirements.

    config STROBE_STACK
        int "Strobe Task Stack Size"
        default 10000
        help
            The size in bytes of the strobe task stack.
            
    config STROBE_PRIO
        int "Strobe Task Priority"
        default 5
        help
            The priority of the strobe task.

endmenu
```

## software/esp-firmware/components/api_connect/Kconfig.projbuild
```kconfig
menu "API Connect"

    config DATA_SERVER
        string "Data Server"
        default "https://bearanvil.com"
        help
            The server to request updated segment speed data from.

    config MAX_DATA_URL_LEN
        int "Max Data URL Length"
        default 60
        help
            The maximum length that the URL of the current data from
            the data server can be, not including null terminator. 
            ex: "https://bearanvil.com/current_data/data_north_V1_0_0.json" -> 57

    config USE_FAKE_DATA
        bool "Use Fake API Data"
        default n
        help
            Whether the TomTom component should simulate API
            data or actually make API calls using the provided API key.

    config MOCK_API_CONNECT
        bool "Mock api_connect Component"
        default n
        help
            Whether to mock the api_connect component or not.

endmenu
```

## software/esp-firmware/components/api_connect/test/Kconfig.projbuild
```kconfig
menu "API Connect Test"

    config TEST_DATA_SERVER
        string "Test Data Server"
        default "https://bearanvil.com"
        help
            The server to request updated segment speed data from.

    config TEST_MAX_DATA_URL_LEN
        int "Test Max Data URL Length"
        default 60
        help
            The maximum length that the URL of the current data from
            the data server can be, not including null terminator. 
            ex: "https://bearanvil.com/current_data/data_north_V1_0_0.json" -> 57

    config TEST_DATA_BASE_URL
        string "Test Data Base URL"
        default "/test_data/test_api_connect_data"
        help
            The base page for the test data files on the test data server.

endmenu
```

## software/esp-firmware/components/app_errors/Kconfig.projbuild
```kconfig
menu "App Errors"

    config FATAL_CAUSES_REBOOT
        bool "Fatal Error Causes Reboot"
        default y
        help
            Whether a fatal error causes a system reboot or not. It is useful
            to turn this off during development, however there will typically
            not be a way to retrieve logs in the field and the system should
            just restart as quickly as possible.

    config ERROR_PERIOD
        int "Error Flash Period"
        default 500
        help
            The amount of time in milliseconds (1/1000th of a second) between 
            error LED toggling for TomTom errors.

endmenu
```

## software/esp-firmware/components/app_nvs/Kconfig.projbuild
```kconfig
menu "app_nvs"

    config MOCK_APP_NVS
        bool "Mock App NVS Component"
        default n
        help
            Whether to mock app_nvs.h or not.

endmenu
```

## software/esp-firmware/components/common/Kconfig.projbuild
```kconfig
menu "Main Application"

    config HARDWARE_VERSION
        int "PCB Hardware Version"
        default 1
        help
            The version of the PCB that this build is running on, which
            lets the firmware know the capabilities of the board.

    config HARDWARE_REVISION
        int "PCB Hardware Revision"
        default 0
        help
            The revision of the PCB that this build is running on, which lets
            the firmware know the capabilities of the board.

    config FIRMWARE_MAJOR_VERSION
        int "Traffic Firmware Major Version"
        default 0
        help
            The major version of firmware this build corresponds to.

    config FIRMWARE_MINOR_VERSION
        int "Traffic Firmware Minor Version"
        default 0
        help
            The minor version of firmware this build corresponds to.

    config FIRMWARE_PATCH_VERSION
        int "Traffic Firmware Patch Version"
        default 0
        help
            The patch version of firmware this build corresponds to.
    
    config SERVER_HARDWARE_VERSION
        int "Server Hardware Version"
        default 1
        help
            The version of hardware this build tells the server it is, however
            it will still grab the correct addendums for the true hardware
            version.

    config SERVER_FIRMWARE_VERSION
        int "Server Firmware Version"
        default 0
        help
            The version of firmware this build tells the server it is. That is,
            it accesses the data file corresponding to this firmware version.

    config FIRMWARE_CONF
        string "Traffic Firmware Configuration"
        default "UUUU"
        help
            An indication of this build's build specific config values.
            Syntax: [A/F/U: api data/fake data/undef][slow color][med color][fast color].

    config FIRST_DIR_NORTH
        bool "Initial Direction is North"
        default true
        help
            Whether the initial direction of traffic flow displayed on the board
            is North or South. If this is true, then North is displayed.

    config LED_REFRESH_PERIOD
        int "LED Refresh Period"
        default 60
        help
            The amount of time in minutes between LED refreshes.

    config LED_UPDATE_PERIOD
        int "LED Update Period"
        default 100
        help
            The amount of time in milliseconds (1/1000th of a second) between 
            LED color updates.

    config LED_CLEAR_PERIOD
        int "LED Clear Period"
        default 100
        help
            The amount of time in milliseconds (1/1000th of a second) between 
            clearing of LEDs.

    config DEBOUNCE_PERIOD
        int "Button Debounce Period"
        default 200
        help
            The amount of time in milliseconds (1/1000th of a second) that
            additional button interrupts will not be registered after an initial interrupt.

    config RETRY_RECONNECT_PERIOD
        int "Retry WIFI Reconnect Period"
        default 500
        help
            The amount of time in milliseconds (1/1000th of a second) between
            attempts to reconnect to the wifi network if disconnected.

    config OTA_LEFT_ON_MS
        int "OTA Left On Time"
        default 1000
        help
            The amount of time to leave the direction LEDs on after an OTA update has failed.

    config NUM_RETRY_HTTP_REQUEST
        int "Num Retry HTTP Request"
        default 5
        help
            The number of times to retry a TomTom HTTP request, which has a 
            small chance to fail to resolve the hostname.

    config FIRMWARE_UPGRADE_SERVER
        string "Firmware Upgrade Server"
        default "https://bearanvil.com"
        help
            The server to query for the latest firmware binary file for this device.
        
    config NVS_ENTRY_BUFFER_LENGTH
        int "NVS Query Buffer Length"
        default 256
        help
            The length of the buffer used when querying NVS entries from the user.
            Therefore this is also the maximum length of NVS entries for this firmware
            image, however old NVS entries from other images may be a different length.

    config TIMER_CAUSES_TOGGLE
        bool "Timer Causes Toggle"
        default false
        help
            Whether the LED refresh timer should cause the current direction
            of traffic being displayed to be toggled.

    config GLOBAL_LED_CURRENT
        int "Global LED Current"
        default 112
        help
            The maximum current that is delivered to an LED, which is also
            the current delivered to an LED with a scaling factor of 0xFF.
            This value should not exceed 0x80 (128) as that corresponds to the
            maximum operating current that an LED can handle.
    
    config SLOW_CUTOFF_PERCENT
        int "Slow LED Cutoff"
        default 50
        help
            The percentage of road segment free flow speed below which the current
            segment speed is considered slow, exclusive of the cutoff. This
            should be lower than MEDIUM_CUTOFF_PERCENT.

    config MEDIUM_CUTOFF_PERCENT
        int "Medium LED Cutoff"
        default 80
        help
            The percentage of road segment free flow speed below which the current
            segment speed is considered medium, exclusive of the cutoff. This should
            be higher than SLOW_CUTOFF_PERCENT.

    config MAIN_PRIO
        int "Priority of the main task"
        default 4
    
    config OTA_STACK
        int "Stack size in bytes of the OTA task"
        default 10000

    config OTA_PRIO
        int "Priority of the OTA task"
        default 3

    config DISABLE_TESTING_FEATURES
        bool "Disable Testing Features"
        default true
        help
            The esp-idf vscode extension likes to, by default, set this false
            when testing. I have no idea why, nor how to change it, but it is
            actually quite useful here because it is on by default for regular
            builds and off for testing!
        
endmenu
```

## software/esp-firmware/components/indicators/KConfig.projbuild
```kconfig
menu "Indicators"

    config MOCK_INDICATORS
        bool "Mock Indicators Component"
        default false
        help
            Whether to use a mock implementation of the indicators component
            or not.

    config EXTERN_INDICATORS_CONFIG
        bool "Extern Indicators Config"
        default false
        help
            Whether to use extern variables instead of macros for configuration
            options in indicators_config.h, which can be useful for testing.

endmenu
```

## software/esp-firmware/components/ota/KConfig.projbuild
```kconfig
menu "OTA"

    config OTA_EXTERN_MACROS
        bool "OTA Extern Macros"
        default false
        help 
            Whether to use extern variables instead of macro definitions for
            configuration options. This allows runtime modification of these
            definitions during testing, while reducing overhead in production.

    config MOCK_OTA
        bool "Mock OTA Component"
        default false
        help
            Whether to mock ota.h or not.

endmenu
```

## software/esp-firmware/components/ota/Kconfig.projbuild
```kconfig
menu "OTA"

    config OTA_EXTERN_MACROS
        bool "OTA Extern Macros"
        default n
        help 
            Whether to use extern variables instead of macro definitions for
            configuration options. This allows runtime modification of these
            definitions during testing, while reducing overhead in production.

    config MOCK_OTA
        bool "Mock OTA Component"
        default n
        help
            Whether to mock ota.h or not.

endmenu
```

## software/esp-firmware/components/ota/test/Kconfig.projbuild
```kconfig
menu "OTA Test"

    config OTA_TEST_DATA_SERVER
        string "Test Data Server"
        default "https://bearanvil.com"
        help
            The server to request updated segment speed data from.

    config OTA_TEST_DATA_BASE_URL
        string "Test Data Base URL"
        default "/test_data/test_ota_data"
        help
            The base page for the test data files on the test data server.

endmenu
```

## software/esp-firmware/components/refresh/KConfig.projbuild
```kconfig
menu "Refresh"

    config MOCK_REFRESH
        bool "Mock Refresh Component"
        default false
        help
            Whether to mock the refresh component or not.

    config EXTERN_REFRESH_CONFIG
        bool "Use Extern refresh_config Macros"
        default false
        help
            Whether to use extern variables instead of macros in refresh_config.h

endmenu
```
