## software/esp-firmware/components/input/Kconfig.projbuild
```kconfig
menu "Input"

    config INPUT_PRIO
        int "Priority of the button tasks"
        default 5
        help
            The priority of the tasks that handle deferred processing of
            button interrupts. These do very little work per event, so they
            sit above the main task to keep button presses responsive.

    config BUTTON_DEBOUNCE_US
        int "Button Debounce Period"
        default 50000
        help
            The amount of time in microseconds to not monitor edges of a button
            GPIO pin after an initial edge is detected.

    config BUTTON_VERIFY_US
        int "Button Verification Period"
        default 10000
        help
            The amount of time in microseconds after the debounce period to
            expect no edges on a button GPIO pin. Otherwise, the debounce
            period is restarted.

    config LONG_BUTTON_PRESS_US
        int "Long Button Press Period"
        default 500000
        help
            The amount of time in microseconds the Toggle button must be held to
            be considered a long button press.

endmenu
```

## software/esp-firmware/components/led_matrix/Kconfig.projbuild
```kconfig
menu "Led Matrix"

    config I2C_GATEKEEPER_STACK
        int "Stack size in bytes of I2C Gatekeeper task"
        default 3584

    config I2C_GATEKEEPER_PRIO
        int "Priority of the I2C Gatekeeper task"
        default 2

    config FAKE_LED_MATRIX
        bool "Fake the led_matrix component"
        default n
        help
            Whether to use the fake of the led_matrix component or not.

endmenu
```

## software/esp-firmware/components/refresh/Kconfig.projbuild
```kconfig
menu "Refresh"

    config MOCK_REFRESH
        bool "Mock Refresh Component"
        default n
        help
            Whether to mock refresh.h or not.

    config TEST_REFRESH
        bool "Test Refresh Component"
        default n
        help
            Whether to include functions useful when testing the refresh
            component.

    config EXTERN_REFRESH_CONFIG
        bool "Use Extern refresh_config Macros"
        default n
        help
            Whether to use extern variables instead of macros in refresh_config.h

endmenu
```
